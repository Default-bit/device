#include <LiquidCrystal.h>  // Библиотека LCD дисплея
LiquidCrystal lcd(7, 6, 5, 4, 3, 2); // (RS, E, DB4, DB5, DB6, DB7)

#include <Ultrasonic.h> // подключаем библиотеку ультразвукового датчика
Ultrasonic ultrasonic(11, 12); // Trig - 11, Echo - 12

//Определим необходимые порты
#define LED_PIN 13 //Светодиод
#define BUZZER  10 //Пищалка
#define MOTOR    9 //Мотор-вибратор

// Зоны оповещения
#define ZONE1 80 // Прерывистый писк с частотой 1 Гц, если расстояние меньше 80 см
#define ZONE2 40 // Прерывистый писк с частотой 2 Гц, если расстояние меньше 40 см
#define ZONE3 15 // Непрерывный писк, если расстояние меньше 15 см

// Значения времени работы и паузы бузера
#define ALARM1 250 // Бузер пищит 250 мс при аларме = 1
#define PAUSE1 750 // Бузер выключен 750 мс при аларме = 1
#define ALARM2 250 // Бузер пищит 250 мс при аларме = 2
#define PAUSE2 250 // Бузер выключен 250 мс при аларме = 2

// Время обновления LCD дисплея
#define LCD_DISPLAY 500 // 2 раза в секунду

int alarm = 0; // Состояние аларма: 0, 1, 2, 3
int st_buz = 0; // Состояние бузера: 0 - выкл, 1 - вкл.
                // под бузером сдесь понимают: пищалку, светодиод и мотор

unsigned long cur_time = 0, disp_time = 0; // для сохранения текущего времени

float dist_cm = 0; // Расстояние в см





// Функция одновременно включает пищалку, светодиод и мотор
void buzzer_on(void) {
  digitalWrite(LED_PIN, HIGH);  //Светодиод ВКЛ
  analogWrite(BUZZER, 50);      //Пищалка ВКЛ
  digitalWrite(MOTOR, HIGH);    //Мотор ВКЛ

  st_buz = 1;
}




// Функция одновременно выключает пищалку, светодиод и мотор
void buzzer_off(void) {
  digitalWrite(LED_PIN, LOW);  //Светодиод ВКЛ
  analogWrite(BUZZER, 0);      //Пищалка ВКЛ
  digitalWrite(MOTOR, LOW);    //Мотор ВКЛ

  st_buz = 0;
}




// Вывод значения расстояния на дисплей
// dist - выводимая дистанция в см
// alarm_zone - текущий аларм
void dist_to_lcd(float dist, int alarm_zone) {
  // Дисплей состоит из двух строк по 16 символов
  // ==============================================
  //   0123456789012345
  // 0: >>>  999   <<<
  // 1: Ultra  Parking
  //
  //   0123456789012345
  // 0:      ---        - если дистанция больше 4 метров
  // 1: Ultra  Parking
  //
  //   0123456789012345
  // 0:      120        - безопасное расстояние (аларм 0)
  // 1: Ultra  Parking
  //
  //   0123456789012345
  // 0: >     70     <  - аларм 1
  // 1: Ultra  Parking
  //
  //   0123456789012345
  // 0: >>    30    <<  - аларм 2
  // 1: Ultra  Parking
  //
  //   0123456789012345
  // 0: >>>   10   <<<  - аларм 1
  // 1: Ultra  Parking
  //

  char str_dst[4] = "";
  char str[20] = "";
  
  if (dist > 400) {
    strcpy(str_dst, "---");
  } else {
    sprintf(str_dst, "%3d", (int)dist);
  }

  switch(alarm_zone) {
    case 0: sprintf(str, "      %s       ", str_dst); break;
    case 1: sprintf(str, " >    %s     < ", str_dst); break;
    case 2: sprintf(str, " >>   %s    << ", str_dst); break;
    case 3: sprintf(str, " >>>  %s   <<< ", str_dst); break;
  }

  lcd.setCursor(0, 0);
  lcd.print(str);
  lcd.setCursor(0, 1);
  lcd.print(" Ultra  Parking ");
}



void setup() {
  // Здесь код выполняется 1 раз
  //Serial.begin(9600); // инициализация послед. порта

  lcd.begin(16, 2);   // Задаем размерность экрана

  // Настройка портов
  pinMode(LED_PIN, OUTPUT);
  pinMode(BUZZER, OUTPUT);
  pinMode(MOTOR, OUTPUT);

  //Выключим все
  buzzer_off();

  // Выведем версию программы на дисплей
  lcd.setCursor(0, 0);
  lcd.print(" Ultra  Parking ");
  lcd.setCursor(0, 1);
  lcd.print("*** Ver 1.00 ***");

  delay(2000);
}




void loop() {
  // Здесь код выполняется вечно
  // Алгоритм парктроника:
  // 1. Измеряем расстояние от ультразвукового датчика до препятствия (выводим на дисплей)
  // 2. Если расстояние меньше 15 см, то непрерывный писк                 (состояние: аларм 3)
  // 3. Если расстояние меньше 40 см, то прерывистый писк с частотой 2 Гц (состояние: аларм 2)
  // 4. Если расстояние меньше 80 см, то прерывистый писк с частотой 1 Гц (состояние: аларм 1)
  // 5. Если расстояние больше 80 см, выключим пищалку                    (состояние: аларм 0)


  // Алгоритм бузера:
  // если состояние аларм 0: выключим бузер, светодиод и мотор
  // если состояние аларм 1: если бузер включен и время аларма 1 прошло, то выключим бузер, светодиод и мотор и снова засечем время
  //                         если бузер выключен и время паузы 1 прошло, то включим бузер, светодиод и мотор и снова засечем время
  // если состояние аларм 2: если бузер включен и время аларма 2 прошло, то выключим бузер, светодиод и мотор и снова засечем время
  //                         если бузер выключен и время паузы 2 прошло, то включим бузер, светодиод и мотор и снова засечем время
  // если состояние аларм 3: включим бузер, светодиод и мотор


  dist_cm = ultrasonic.Ranging(CM); // 1. Измеряем расстояние от ультразвукового датчика до препятствия

  // Вывод дистанции на дисплей
  if ((millis() - disp_time) > LCD_DISPLAY) {
    dist_to_lcd(dist_cm, alarm);
    disp_time = millis();
  }

  if (dist_cm < ZONE3) {
    alarm = 3; //Установим аларм = 3
  } else if (dist_cm < ZONE2) {
    alarm = 2; //Установим аларм = 2
  } else if (dist_cm < ZONE1) {
    alarm = 1; //Установим аларм = 1
  } else {
    alarm = 0; //Установим аларм = 0
  }


  switch (alarm) {
    case 0: // аларм = 0. Выключим бузер, светодиод и мотор
            buzzer_off();
            break;

    case 1: // аларм = 1. Прерывистый писк с частотой 1 Гц
            if ((st_buz == 0) && ((millis() - cur_time) > PAUSE1)) {
              // то включим бузер, светодиод и мотор и снова засечем время
              buzzer_on();
              cur_time = millis();
            } else if ((st_buz == 1) && ((millis() - cur_time) > ALARM1)) {
              // то выключим бузер, светодиод и мотор и снова засечем время
              buzzer_off();
              cur_time = millis();
            }
            break;

    case 2: // аларм = 2. Прерывистый писк с частотой 2 Гц
            if ((st_buz == 0) && ((millis() - cur_time) > PAUSE2)) {
              // то включим бузер, светодиод и мотор и снова засечем время
              buzzer_on();
              cur_time = millis();
            } else if ((st_buz == 1) && ((millis() - cur_time) > ALARM2)) {
              // то выключим бузер, светодиод и мотор и снова засечем время
              buzzer_off();
              cur_time = millis();
            }
            break;

    case 3: // аларм = 3. Непрерывный писк
            buzzer_on();
            break;
            
  } //switch
}










